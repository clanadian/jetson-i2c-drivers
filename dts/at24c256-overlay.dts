/dts-v1/;
/plugin/;

/ {
    overlay-name = "AT24C256 on I2C1";
    compatible = "nvidia,tegra210";

    fragment@0 {
        target-path = "/i2c@7000c400";
        __overlay__ {
            #address-cells = <1>;
            #size-cells = <0>;
            status = "okay";

            at24c256@50 {
                compatible = "at24c256-i2c";
                reg = <0x50>;                /* A0~A2 = GND 기준 */
            };
        };
    };
};
